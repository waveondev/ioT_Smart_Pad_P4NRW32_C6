## main/Kconfig.projbuild
```kconfig
menu "Smart Pad Camera Configuration"

    config CAM_FRAME_WIDTH
        int "Camera Frame Width"
        default 1920
        help
            Width of the camera frame in pixels.

    config CAM_FRAME_HEIGHT
        int "Camera Frame Height"
        default 1080
        help
            Height of the camera frame in pixels.

    config RTSP_SERVER_PORT
        int "RTSP Server Port"
        default 8554
        help
            Port for the RTSP streaming server.

    config CAM_SCCB_SCL_IO
        int "SCCB SCL GPIO Pin"
        default 7
        help
            GPIO pin number for I2C SCL.

    config CAM_SCCB_SDA_IO
        int "SCCB SDA GPIO Pin"
        default 8
        help
            GPIO pin number for I2C SDA.

endmenu
```

## sdkconfig.defaults
```kconfig
# ==============================================================================
# ESP32-P4 + ESP32-C6 ESP-Hosted SDIO Configuration (Guition / WAVEON Standard)
# ==============================================================================

# 1. Target Chip
CONFIG_IDF_TARGET="esp32p4"
CONFIG_ESP32P4_SELECTS_REV_LESS_V3=y
CONFIG_ESP32P4_REV_MIN_0=y

# 2. Flash Size
CONFIG_ESPTOOLPY_FLASHSIZE_16MB=y
CONFIG_ESPTOOLPY_FLASHSIZE="16MB"

# 3. esp_hosted Framework Enable
CONFIG_ESP_HOSTED=y
CONFIG_ESP_HOSTED_HOST=y
CONFIG_ESP_HOSTED_HOST_TYPE_MCU=y
CONFIG_ESP_HOSTED_CP_TARGET_ESP32C6=y

# 4. SDIO Bus Configuration (4-Bit 紐⑤뱶 蹂듭썝)
CONFIG_ESP_HOSTED_HOST_TRANSPORT_BUS_SDIO=y
CONFIG_ESP_HOSTED_HOST_SDIO_SLOT=1
CONFIG_ESP_HOSTED_HOST_SDIO_CLK_KHZ=40000
CONFIG_ESP_HOSTED_HOST_SDIO_BUS_WIDTH_4=y
CONFIG_ESP_HOSTED_HOST_SDIO_BUS_WIDTH_1=n

# SDMMC ?대? ???媛뺤젣 ?쒖꽦??(DAT1 ?명꽣?쏀듃 ?쇱씤 Floating 諛⑹?)
CONFIG_SDMMC_INTERNAL_PULLUPS=y

# Guition / WAVEON 怨듭떇 C6 RESET GPIO 54 (Active High)
CONFIG_ESP_HOSTED_HOST_RESET_GPIO=54
CONFIG_ESP_HOSTED_HOST_RESET_ACTIVE_HIGH=y
CONFIG_ESP_HOSTED_HOST_CP_RESET_STRATEGY_ALWAYS=y

# GPIO 留ㅽ븨 (P4 SDIO Slot 1)
CONFIG_ESP_HOSTED_HOST_SDIO_PIN_CLK=18
CONFIG_ESP_HOSTED_HOST_SDIO_PIN_CMD=19
CONFIG_ESP_HOSTED_HOST_SDIO_PIN_D0=14
CONFIG_ESP_HOSTED_HOST_SDIO_PIN_D1=15
CONFIG_ESP_HOSTED_HOST_SDIO_PIN_D2=16
CONFIG_ESP_HOSTED_HOST_SDIO_PIN_D3=17

# 5. RPC 諛??쒖뒪??湲곕뒫 ?쒖꽦??
CONFIG_ESP_HOSTED_HOST_FEAT_RPC=y
CONFIG_ESP_HOSTED_HOST_FEAT_RPC_EXT_V2=y
CONFIG_ESP_HOSTED_HOST_FEAT_SYSTEM=y
CONFIG_ESP_HOSTED_HOST_AUTO_FEAT_INIT=y

# 6. P4 ?⑥묩 Wi-Fi 鍮꾪솢?깊솕 諛?ESP-Hosted 媛??Wi-Fi ?섏떊 ?붿뒪?⑥쿂 ?쒖꽦??
CONFIG_ESP_HOST_WIFI_ENABLED=n
CONFIG_ESP_HOSTED_HOST_FEAT_WIFI=y

# Remote Wi-Fi / Hosted 諛깆뿏???ㅼ젙
CONFIG_ESP_WIFI_REMOTE_ENABLED=y
CONFIG_ESP_WIFI_REMOTE_LIBRARY_HOSTED=y

# 7. Auto-Init Disable
CONFIG_ESP_HOSTED_AUTO_CALL_INIT_BEFORE_APP_MAIN=n
CONFIG_ESP_HOSTED_HOST_CP_RESET_SETTLE_MS=1500
CONFIG_ESP_HOSTED_HOST_CP_BRINGUP_TIMEOUT_MS=10000
CONFIG_ESP_HOSTED_HOST_RPC_TIMEOUT_MS=8000

CONFIG_PARTITION_TABLE_CUSTOM=y
CONFIG_PARTITION_TABLE_CUSTOM_FILENAME="partitions.csv"
CONFIG_PARTITION_TABLE_FILENAME="partitions.csv"
# ESP32-P4 PSRAM Configuration


# ESP32-P4 PSRAM 200MHz Configuration
CONFIG_IDF_EXPERIMENTAL_FEATURES=y
CONFIG_SPIRAM=y
CONFIG_SPIRAM_SPEED_200M=y
CONFIG_SPIRAM_BOOT_INIT=y
CONFIG_SPIRAM_USE_MALLOC=y
```
